VERSION ""

NS_ :

BS_:

BU_:

BO_ 16 DynamicsControllerGains: 8 Vector__XXX
 SG_ TractionControlGain : 32|32@1- (1,0) [0|1] "" Vector__XXX
 SG_ TorqueVectoringGain : 0|32@1- (1,0) [0|1] "" Vector__XXX

BO_ 65 DriverOverrideFromCar: 1 Vector__XXX
 SG_ DriverOverride : 7|8@0- (1,0) [0|1] "" Vector__XXX

BO_ 64 DriverOverrideToCar: 1 Vector__XXX
 SG_ DriverOverride : 7|8@0- (1,0) [0|1] "" Vector__XXX

BO_ 48 WheelSpeeds: 8 Vector__XXX
 SG_ RearWheelSpeed : 39|32@0- (1,0) [-3.4E+038|3.4E+038] "" Vector__XXX
 SG_ FrontWheelSpeed : 7|32@0- (1,0) [-3.4E+038|3.4E+038] "" Vector__XXX

BO_ 32 DriverControlsToCar: 8 Vector__XXX
 SG_ SteeringInput : 32|32@1- (1,0) [-3.4E+038|3.4E+038] "" Vector__XXX
 SG_ ThrottleInput : 0|32@1- (1,0) [-3.4E+038|3.4E+038] "" Vector__XXX

BO_ 33 DriverControlsFromCar: 8 Vector__XXX
 SG_ SteeringInput : 32|32@1- (1,0) [-3.4E+038|3.4E+038] "" Vector__XXX
 SG_ ThrottleInput : 0|32@1- (1,0) [-3.4E+038|3.4E+038] "" Vector__XXX

BA_DEF_  "BusType" STRING ;
BA_DEF_DEF_  "BusType" "CAN";
SIG_VALTYPE_ 16 TractionControlGain : 1;
SIG_VALTYPE_ 16 TorqueVectoringGain : 1;
SIG_VALTYPE_ 48 RearWheelSpeed : 1;
SIG_VALTYPE_ 48 FrontWheelSpeed : 1;
SIG_VALTYPE_ 32 SteeringInput : 1;
SIG_VALTYPE_ 32 ThrottleInput : 1;
SIG_VALTYPE_ 33 SteeringInput : 1;
SIG_VALTYPE_ 33 ThrottleInput : 1;
